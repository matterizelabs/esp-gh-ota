## Kconfig.projbuild
```kconfig
menu "ESP GitHub OTA"

    config ESP_GH_OTA_RECV_TIMEOUT
        int "OTA receive timeout (ms)"
        default 30000
        help
            Maximum time for reception of the firmware image over HTTPS.

    config ESP_GH_OTA_BUF_SIZE
        int "OTA buffer size (bytes)"
        default 1024
        range 1024 65536
        help
            Buffer size for OTA data transfers in bytes.

    config ESP_GH_OTA_POLL_INTERVAL_SEC
        int "Default poll interval (seconds)"
        default 300
        range 60 86400
        help
            How often to check GitHub for new releases, in seconds.
            Default: 300 (5 minutes). Minimum: 60 (1 minute).

    config ESP_GH_OTA_DEFAULT_OWNER
        string "Default GitHub owner/org"
        default ""
        help
            Default GitHub username or organization. Can be changed at
            runtime via the HTTP API (POST /api/config).

    config ESP_GH_OTA_DEFAULT_REPO
        string "Default GitHub repository"
        default ""
        help
            Default GitHub repository name. Can be changed at runtime
            via the HTTP API (POST /api/config).

    config ESP_GH_OTA_ENABLE_PARTIAL_DOWNLOAD
        bool "Enable partial HTTP download"
        default n
        select ESP_HTTPS_OTA_ENABLE_PARTIAL_DOWNLOAD
        select ESP_TLS_CLIENT_SESSION_TICKETS
        help
            Download the firmware image over multiple HTTP Range requests.
            Useful when the TLS in-content length is smaller than the image.

    config ESP_GH_OTA_PARTIAL_REQUEST_SIZE
        int "Partial HTTP request size (bytes)"
        default MBEDTLS_SSL_IN_CONTENT_LEN
        depends on ESP_GH_OTA_ENABLE_PARTIAL_DOWNLOAD
        help
            Number of bytes downloaded in a single HTTP request.

    config ESP_GH_OTA_ENABLE_RESUMPTION
        bool "Enable OTA resumption"
        default n
        select ESP_HTTPS_OTA_ENABLE_RESUMPTION
        help
            Resume the OTA download from where it left off after a reboot.
            Tracks bytes written and the asset URL in NVS.

    config ESP_GH_OTA_API_KEY
        string "Pre-shared API key for /api/config"
        default ""
        help
            When non-empty, the HTTP config endpoint (GET and POST
            /api/config) requires an X-API-Key header matching this
            value. Leave empty to disable authentication — the config
            API is then open on the LAN.

            Set this in sdkconfig.secrets (gitignored) so the key is
            not committed to version control.

endmenu
```

## example/sdkconfig.defaults
```kconfig
CONFIG_ESPTOOLPY_FLASHSIZE_4MB=y
CONFIG_PARTITION_TABLE_TWO_OTA_LARGE=y

CONFIG_MBEDTLS_CERTIFICATE_BUNDLE_DEFAULT_CMN=y
CONFIG_MBEDTLS_TLS_CLIENT_ONLY=y

CONFIG_ESP_MAIN_TASK_STACK_SIZE=8192
CONFIG_ESP_MAIN_TASK_AFFINITY_CPU0=y
CONFIG_ESP_TASK_WDT_INIT=n
CONFIG_BOOTLOADER_COMPILER_OPTIMIZATION_SIZE=y
CONFIG_COMPILER_OPTIMIZATION_SIZE=y

CONFIG_ESP_GH_OTA_BUF_SIZE=1024
CONFIG_ESP_GH_OTA_RECV_TIMEOUT=30000

# Resume an interrupted OTA across reboots (partial Range download + NVS checkpoint)
CONFIG_ESP_GH_OTA_ENABLE_PARTIAL_DOWNLOAD=y
CONFIG_ESP_GH_OTA_ENABLE_RESUMPTION=y

# Anti-rollback: reject firmware whose secure_version is below the eFuse value.
# WARNING: enabling this burns eFuses one-way. Do not enable on a dev device
# unless you manage secure_version bumping per release.
CONFIG_BOOTLOADER_APP_ANTI_ROLLBACK=y
```

## main/Kconfig.projbuild
```kconfig
menu "Example Configuration"

    config EXAMPLE_FIRMWARE_UPGRADE_URL
        string "Firmware Upgrade URL"
        default "https://192.168.2.106:8070/hello_world.bin"
        help
            URL of server which hosts the firmware image.

    config EXAMPLE_FIRMWARE_UPGRADE_URL_FROM_STDIN
        bool
        default y if EXAMPLE_FIRMWARE_UPGRADE_URL = "FROM_STDIN"

    config EXAMPLE_SKIP_COMMON_NAME_CHECK
        bool "Skip server certificate CN fieldcheck"
        default n
        help
            This allows you to skip the validation of OTA server certificate CN field.

    config EXAMPLE_SKIP_VERSION_CHECK
        bool "Skip firmware version check"
        default n
        help
            This allows you to skip the firmware version check.

    config EXAMPLE_OTA_RECV_TIMEOUT
        int "OTA Receive Timeout"
        default 5000
        help
            Maximum time for reception

    config EXAMPLE_ENABLE_PARTIAL_HTTP_DOWNLOAD
        bool "Enable partial HTTP download"
        default n
        select ESP_HTTPS_OTA_ENABLE_PARTIAL_DOWNLOAD
        select ESP_TLS_CLIENT_SESSION_TICKETS
        help
            This enables use of Range header in esp_https_ota component.
            The firmware image will be downloaded over multiple HTTP requests,
            with session resumption enabled between them.

    config EXAMPLE_HTTP_REQUEST_SIZE
        int "HTTP request size"
        default MBEDTLS_SSL_IN_CONTENT_LEN
        depends on EXAMPLE_ENABLE_PARTIAL_HTTP_DOWNLOAD
        help
            This options specifies HTTP request size. Number of bytes specified
            in this option will be downloaded in single HTTP request.

    config EXAMPLE_ENABLE_OTA_RESUMPTION
        bool "Enable OTA resumption"
        default n
        help
            This enables the OTA resumption feature.
            This option allows one to configure the OTA process to resume downloading the OTA image
            from where it left off in case of an error or reboot.

    config EXAMPLE_OTA_BUF_SIZE
        int "OTA buffer size"
        default 1024
        range 1024 65536
        help
            Buffer size for OTA data transfers in bytes.

    config EXAMPLE_USE_CERT_BUNDLE
        bool "Enable certificate bundle"
        default y
        depends on MBEDTLS_CERTIFICATE_BUNDLE
        help
            Enable trusted root certificate bundle. This approach allows to have
            OTA updates functional with any public server without requirement
            to explicitly add its server certificate.

    config EXAMPLE_GITHUB_OTA_ENABLE
        bool "Enable GitHub Releases OTA"
        default y
        help
            Enable periodic polling of GitHub Releases API to check for
            firmware updates. When a new release tag is found, the device
            downloads and flashes the firmware binary from the release assets.

    config EXAMPLE_GITHUB_POLL_INTERVAL_SEC
        int "GitHub poll interval (seconds)"
        default 300
        depends on EXAMPLE_GITHUB_OTA_ENABLE
        range 60 86400
        help
            How often to check GitHub for new releases, in seconds.
            Default: 300 (5 minutes). Minimum: 60 (1 minute).

    config EXAMPLE_GITHUB_DEFAULT_OWNER
        string "Default GitHub owner/org"
        default ""
        depends on EXAMPLE_GITHUB_OTA_ENABLE
        help
            Default GitHub username or organization. Can be changed at
            runtime via the HTTP API (POST /api/config).

    config EXAMPLE_GITHUB_DEFAULT_REPO
        string "Default GitHub repository"
        default ""
        depends on EXAMPLE_GITHUB_OTA_ENABLE
        help
            Default GitHub repository name. Can be changed at runtime
            via the HTTP API (POST /api/config).

endmenu
```
